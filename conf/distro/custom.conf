## conf/distro/custom.conf
```bitbake
require conf/distro/poky.conf

DISTRO_FEATURES = "systemd ipv4 wifi "

VIRTUAL-RUNTIME_init_manager = "systemd"
DISTRO_FEATURES_BACKFILL_CONSIDERED += "sysvinit"
VIRTUAL-RUNTIME_login_manager = "busybox"
VIRTUAL-RUNTIME_syslog = ""
VIRTUAL-RUNTIME_initscripts = "systemd-compat-units"

INIT_MANAGER = "systemd"
```
